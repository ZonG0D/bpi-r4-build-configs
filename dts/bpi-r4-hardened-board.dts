// SPDX-License-Identifier: MIT
/dts-v1/;

#include "bpi-r4-hardened-board.dtsi"

/ {
    compatible = "bananapi,bpi-r4", "mediatek,mt7988a";
    model = "Banana Pi BPI-R4 (hardened add-ons)";
    chassis-type = "embedded";
};
