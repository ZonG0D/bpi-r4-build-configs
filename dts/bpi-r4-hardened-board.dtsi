// SPDX-License-Identifier: MIT
#include <dt-bindings/gpio/gpio.h>
#include <dt-bindings/leds/common.h>

#define BPI_R4_PWM_PHANDLE &{/soc/pwm@10048000}
#define BPI_R4_PIO_PHANDLE &{/pinctrl@10005000}
#include "bpi-r4-hardened-common.dtsi"
