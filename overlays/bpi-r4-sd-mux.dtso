// SPDX-License-Identifier: MIT
/dts-v1/;
/plugin/;

#include <dt-bindings/gpio/gpio.h>

/* SD host at 0x11230000 exists on MT7988; uses standard 'pio' label */
&{/soc/mmc@11230000} {
    pinctrl-names = "default", "state_uhs";
    pinctrl-0 = <&mmc0_pins_sdcard>;
    pinctrl-1 = <&mmc0_pins_sdcard>;

    cd-gpios = <&pio 12 GPIO_ACTIVE_LOW>;
    bus-width = <4>;
    max-frequency = <52000000>;
    cap-sd-highspeed;

    vmmc-supply  = <&reg_3p3v>;
    vqmmc-supply = <&reg_3p3v>;

    no-mmc;
    #address-cells = <1>;
    #size-cells = <0>;
    status = "okay";
};
